AUTOSAR XML (schema 4.0)
package /Hady
  module config Dcm
    ecuc param conf container DcmConfigSet: destination=AUTOSAR/Hady/Dcm/DcmConfigSet
      5 x ecuc param conf container:
        DcmDsd: destination=AUTOSAR/Hady/Dcm/DcmConfigSet/DcmDsd
          ecuc boolean param value DcmDsdRequestManufacturerNotificationEnabled: value=0
          ecuc boolean param value DcmDsdRequestSupplierNotificationEnabled: value=0
        DcmDsl: destination=AUTOSAR/Hady/Dcm/DcmConfigSet/DcmDsl
          4 x ecuc param conf container:
            DcmDslBuffer_0: destination=AUTOSAR/Hady/Dcm/DcmConfigSet/DcmDsl/DcmDslBuffer/DcmDslBuffer_0
              ecuc integer param value DcmDslBufferSize: value=0
            DcmDslCallbackDCMRequestService_0: destination=AUTOSAR/Hady/Dcm/DcmConfigSet/DcmDsl/DcmDslCallbackDCMRequestService/DcmDslCallbackDCMRequestService_0
            DcmDslDiagResp: destination=AUTOSAR/Hady/Dcm/DcmConfigSet/DcmDsl/DcmDslDiagResp
              ecuc integer param value DcmDslDiagRespMaxNumRespPend: value=0
              ecuc boolean param value DcmDslDiagRespOnSecondDeclinedRequest: value=0
            DcmDslProtocol: destination=AUTOSAR/Hady/Dcm/DcmConfigSet/DcmDsl/DcmDslProtocol
        DcmDsp: destination=AUTOSAR/Hady/Dcm/DcmConfigSet/DcmDsp
          ecuc enumeration param value DcmDspDataDefaultEndianness: value=BIG_ENDIAN
          ecuc boolean param value DcmDspDDDIDcheckPerSourceDID: value=1
          ecuc boolean param value DcmDspEnableObdMirror: value=1
          ecuc integer param value DcmDspMaxDidToRead: value=22
          ecuc integer param value DcmDspMaxPeriodicDidToRead: value=36545
          ecuc integer param value DcmDspPowerDownTime: value=67
          ecuc enumeration param value DcmResponseToEcuReset: value=AFTER_RESET
          19 x ecuc param conf container:
            DcmDspClearDTC: destination=AUTOSAR/Hady/Dcm/DcmConfigSet/DcmDsp/DcmDspClearDTC
              ecuc function name value DcmDspClearDTCCheckFnc
              ecuc reference DcmDspClearDTCModeRuleRef
            DcmDspComControl: destination=AUTOSAR/Hady/Dcm/DcmConfigSet/DcmDsp/DcmDspComControl
            DcmDspCommonAuthorization_0: destination=AUTOSAR/Hady/Dcm/DcmConfigSet/DcmDsp/DcmDspCommonAuthorization/DcmDspCommonAuthorization_0
              ecuc reference DcmDspCommonAuthorizationModeRuleRef
              ecuc reference DcmDspCommonAuthorizationSecurityLevelRef
              ecuc reference DcmDspCommonAuthorizationSessionRef
            DcmDspControlDTCSetting: destination=AUTOSAR/Hady/Dcm/DcmConfigSet/DcmDsp/DcmDspControlDTCSetting
              ecuc reference DcmDspControlDTCSettingReEnableModeRuleRef
            DcmDspData_0: destination=AUTOSAR/Hady/Dcm/DcmConfigSet/DcmDsp/DcmDspData/DcmDspData_0
              ecuc integer param value DcmDspDataByteSize
              ecuc function name value DcmDspDataConditionCheckReadFnc
              ecuc boolean param value DcmDspDataConditionCheckReadFncUsed
              ecuc function name value DcmDspDataEcuSignal
              ecuc enumeration param value DcmDspDataEndianness
              8 x ecuc function name value:
                DcmDspDataFreezeCurrentStateFnc
                DcmDspDataGetScalingInfoFnc
                DcmDspDataReadDataLengthFnc
                DcmDspDataReadEcuSignal
                DcmDspDataReadFnc
                DcmDspDataResetToDefaultFnc
                DcmDspDataReturnControlToEcuFnc
                DcmDspDataShortTermAdjustmentFnc
              ecuc enumeration param value DcmDspDataType
              ecuc enumeration param value DcmDspDataUsePort
              ecuc function name value DcmDspDataWriteFnc
              ecuc reference DcmDspDataBlockIdRef
              ecuc reference DcmDspDataInfoRef
            DcmDspDataInfo_0: destination=AUTOSAR/Hady/Dcm/DcmConfigSet/DcmDsp/DcmDspDataInfo/DcmDspDataInfo_0
              ecuc integer param value DcmDspDataScalingInfoSize
            DcmDspDid_0: destination=AUTOSAR/Hady/Dcm/DcmConfigSet/DcmDsp/DcmDspDid/DcmDspDid_0
              ecuc integer param value DcmDspDidIdentifier
              ecuc integer param value DcmDspDidSize
              ecuc boolean param value DcmDspDidUsed
              ecuc reference DcmDspDidInfoRef
              ecuc reference DcmDspDidRef
            DcmDspDidInfo_0: destination=AUTOSAR/Hady/Dcm/DcmConfigSet/DcmDsp/DcmDspDidInfo/DcmDspDidInfo_0
              ecuc integer param value DcmDspDDDIDMaxElements
              ecuc boolean param value DcmDspDidDynamicallyDefined
            DcmDspDidRange_0: destination=AUTOSAR/Hady/Dcm/DcmConfigSet/DcmDsp/DcmDspDidRange/DcmDspDidRange_0
              ecuc boolean param value DcmDspDidRangeHasGaps: value=0
              ecuc integer param value DcmDspDidRangeIdentifierLowerLimit: value=4654
              ecuc integer param value DcmDspDidRangeIdentifierUpperLimit: value=0
              ecuc function name value DcmDspDidRangeIsDidAvailableFnc
              ecuc integer param value DcmDspDidRangeMaxDataLength: value=0
              ecuc function name value DcmDspDidRangeReadDataLengthFnc
              ecuc function name value DcmDspDidRangeReadDidFnc
              ecuc boolean param value DcmDspDidRangeUsePort: value=1
              ecuc function name value DcmDspDidRangeWriteDidFnc
              ecuc reference DcmDspDidRangeInfoRef
            DcmDspMemory: destination=AUTOSAR/Hady/Dcm/DcmConfigSet/DcmDsp/DcmDspMemory
            DcmDspPeriodicTransmission: destination=AUTOSAR/Hady/Dcm/DcmConfigSet/DcmDsp/DcmDspPeriodicTransmission
              ecuc integer param value DcmDspMaxPeriodicDidScheduler
              ecuc float param value DcmDspPeriodicTransmissionFastRate
              ecuc float param value DcmDspPeriodicTransmissionMediumRate
              ecuc float param value DcmDspPeriodicTransmissionSlowRate
            DcmDspPid_0: destination=AUTOSAR/Hady/Dcm/DcmConfigSet/DcmDsp/DcmDspPid/DcmDspPid_0
              ecuc integer param value DcmDspPidIdentifier
              ecuc enumeration param value DcmDspPidService
              ecuc integer param value DcmDspPidSize
              ecuc boolean param value DcmDspPidUsed
            DcmDspRequestControl_0: destination=AUTOSAR/Hady/Dcm/DcmConfigSet/DcmDsp/DcmDspRequestControl/DcmDspRequestControl_0
              4 x ecuc integer param value:
                DcmDspRequestControlInBufferSize
                DcmDspRequestControlInfoByte
                DcmDspRequestControlOutBufferSize
                DcmDspRequestControlTestId
            DcmDspRequestFileTransfer: destination=AUTOSAR/Hady/Dcm/DcmConfigSet/DcmDsp/DcmDspRequestFileTransfer
              ecuc integer param value DcmRequestFileTransferFileSizeParameterLength
              ecuc integer param value DcmRequestFileTransferLengthFormatIdentifier
            DcmDspRoe: destination=AUTOSAR/Hady/Dcm/DcmConfigSet/DcmDsp/DcmDspRoe
              ecuc float param value DcmDspRoeInterMessageTime
            DcmDspRoutine_0: destination=AUTOSAR/Hady/Dcm/DcmConfigSet/DcmDsp/DcmDspRoutine/DcmDspRoutine_0
              ecuc integer param value DcmDspRoutineIdentifier
              ecuc integer param value DcmDspRoutineInfoByte
              ecuc boolean param value DcmDspRoutineUsed
              ecuc boolean param value DcmDspRoutineUsePort
            DcmDspSecurity: destination=AUTOSAR/Hady/Dcm/DcmConfigSet/DcmDsp/DcmDspSecurity
              ecuc float param value DcmDspSecurityMaxAttemptCounterReadoutTime
            DcmDspSession: destination=AUTOSAR/Hady/Dcm/DcmConfigSet/DcmDsp/DcmDspSession
            DcmDspVehInfo_0: destination=AUTOSAR/Hady/Dcm/DcmConfigSet/DcmDsp/DcmDspVehInfo/DcmDspVehInfo_0
              ecuc integer param value DcmDspVehInfoInfoType
              ecuc boolean param value DcmDspVehInfoNODIProvResp: value=false
        DcmPageBufferCfg: destination=AUTOSAR/Hady/Dcm/DcmConfigSet/DcmPageBufferCfg
          ecuc boolean param value DcmPagedBufferEnabled: value=0
        DcmProcessingConditions: destination=AUTOSAR/Hady/Dcm/DcmConfigSet/DcmProcessingConditions
    ecuc param conf container DcmGeneral: destination=AUTOSAR/Hady/Dcm/DcmGeneral
      ecuc boolean param value DcmDDDIDStorage: value=0
      ecuc boolean param value DcmDevErrorDetect: value=0
      ecuc string param value DcmHeaderFileInclusion: value=233
      ecuc boolean param value DcmRespondAllRequest: value=1
      ecuc float param value DcmTaskTime: value=33
      ecuc boolean param value DcmVersionInfoApi: value=1
      ecuc reference DcmVinRef
